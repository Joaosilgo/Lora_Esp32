#include <AsyncTCP.h>
#include "ESPAsyncWebServer.h"
#include <SPIFFS.h>
// Import required libraries
#include "WiFi.h"
#include <qrcode.h>

/*********
  Rui Santos
  Complete project details at https://RandomNerdTutorials.com/ttgo-lora32-sx1276-arduino-ide/
*********/

//Libraries for LoRa
#include <SPI.h>
#include <LoRa.h>

//Libraries for OLED Display
#include <Wire.h>
#include <Adafruit_GFX.h>
#include <Adafruit_SSD1306.h>
//#include <Fonts/FreeMono9pt7b.h>

//define the pins used by the LoRa transceiver module
#define SCK 5
#define MISO 19
#define MOSI 27
#define SS 18
#define RST 14
#define DIO0 26


//Button

#define BUTTONPIN 0



//433E6 for Asia
//866E6 for Europe
//915E6 for North America
#define BAND 866E6

//OLED pins
#define OLED_SDA 4
#define OLED_SCL 15
#define OLED_RST 16
#define SCREEN_WIDTH 128 // OLED display width, in pixels
#define SCREEN_HEIGHT 64 // OLED display height, in pixels


// Replace with your network credentials
const char* ssid = "";
const char* password = "";

Adafruit_SSD1306 display(SCREEN_WIDTH, SCREEN_HEIGHT, &Wire, OLED_RST);

static const unsigned char PROGMEM splash [] = {
  0x00, 0x00, 0x00, 0x00, 0x00, 0x00, 0x00, 0x00, 0x00, 0x00, 0x00, 0x00, 0x00, 0x00, 0x00, 0x00,
  0x00, 0x00, 0x00, 0x00, 0x00, 0x00, 0x00, 0x01, 0xc0, 0x00, 0x00, 0x00, 0x00, 0x00, 0x00, 0x00,
  0x00, 0x00, 0x00, 0x00, 0x00, 0x00, 0x00, 0x07, 0xe0, 0x00, 0x00, 0x00, 0x00, 0x00, 0x00, 0x00,
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  0x00, 0x00, 0x00, 0x00, 0x00, 0x00, 0x00, 0x00, 0x00, 0x00, 0x00, 0x00, 0x00, 0x00, 0x00, 0x00
};






void IRAM_ATTR toggleButton() {

  Serial.println("Button Toggle !");

}

void  showScreen1( String LoRaData, int  rssi, int packetSize  ) {
  display.clearDisplay();
  display.setCursor(5, 5);
  display.print("LoRa Gateway");
  display.setCursor(5, 20);
  display.print("Received packet:");
  display.setCursor(5, 30);
  display.print(LoRaData);
  display.setCursor(5, 40);
  display.print("Rssi: ");
  display.setCursor(45, 40);
  display.print(rssi);
  display.setCursor(5, 50);
  display.print("Size: ");
  display.setCursor(45, 50);
  display.print(packetSize);
  display.display();
  //display.startscrollright(0x00, 0x00);
  //display.startscrollright(0x00, 0x00);
  //delay(2000);
  //display.stopscroll();
}


void showScreen2(const char *info) {
  QRCode qrcode;
  uint8_t qrcodeData[qrcode_getBufferSize(3)];
  qrcode_initText(&qrcode, qrcodeData, 3 , 0 , info);
  display.clearDisplay();
  for (uint8_t y = 0; y < qrcode.size; y++) {
    for (uint8_t x = 0; x < qrcode.size; x++) {
      display.setCursor(x + 40 , y + 20);
      if (qrcode_getModule(&qrcode, x, y)) {
        display.setTextColor(WHITE);
        Serial.print("##");
        display.drawPixel(x + 20 , y + 20, WHITE);

      } else {
        Serial.print("  ");
        display.setTextColor(BLACK);
        display.drawPixel(x + 20 , y + 20, BLACK);
      }
    }
    Serial.print("\n");
    //display.print("\n");
  }

  //display.setCursor(0, 55);
  // display.print(info);

  display.display();
}

void splashScreen() {

  display.clearDisplay();
  display.drawBitmap(0, 0, splash, 128, 64, 1);
  display.display();

}




String LoRaData;
//Set Webserver in port 80
AsyncWebServer server(80);

void setup() {

  //Initiate Serial
  //Initialize Serial Monitor
  Serial.begin(115200);

  //reset OLED display via software
  pinMode(OLED_RST, OUTPUT);
  digitalWrite(OLED_RST, LOW);
  delay(20);
  digitalWrite(OLED_RST, HIGH);

  //initialize OLED
  Wire.begin(OLED_SDA, OLED_SCL);
  if (!display.begin(SSD1306_SWITCHCAPVCC, 0x3c, false, false)) { // Address 0x3C for 128x32
    Serial.println(F("SSD1306 allocation failed"));
    for (;;); // Don't proceed, loop forever
  }

  //Button
  pinMode(BUTTONPIN, INPUT);
  attachInterrupt(BUTTONPIN, toggleButton, FALLING);

  //Splash Screen
  splashScreen();
  delay(3000);



  display.clearDisplay();
  display.setTextColor(WHITE);
  display.setTextSize(1);
  


  Serial.println("LoRa Receiver Test");

  //SPI LoRa pins
  SPI.begin(SCK, MISO, MOSI, SS);
  //setup LoRa transceiver module
  LoRa.setPins(SS, RST, DIO0);

  if (!LoRa.begin(BAND)) {
    Serial.println("Starting LoRa failed!");
    while (1);
  }
  
  Serial.println("LoRa Initializing OK!");
  display.setCursor(20, 5);
  display.print("LoRa Gateway");
  display.setCursor(0, 15);
  display.print("LoRa Initializing OK!");
  display.display();


  // Connect to Wi-Fi
  WiFi.begin(ssid, password);
  while (WiFi.status() != WL_CONNECTED) {
    delay(1000);
    Serial.println("Connecting to WiFi..");
    display.setCursor(0, 30);
    display.print("Connecting to WiFi..");
    display.display();
  }

  // Print ESP32 Local IP Address
  Serial.println(WiFi.localIP());
  display.setCursor(0, 40);
  display.print(WiFi.localIP());
  display.display();


  //delay(2000);
  //display.clearDisplay();
  if (!SPIFFS.begin()) {
    Serial.println("An Error has occurred while mounting SPIFFS");
    //display.setCursor(0, 20);
    //display.println("An Error has occurred while mounting SPIFFS");
    return;
  }


  // Route for root / web page
  server.on("/", HTTP_GET, [](AsyncWebServerRequest * request) {
    request->send(SPIFFS, "/index.html");
  });
  server.begin();
  Serial.println("HTTP server started");
  //display.setCursor(0, 20);
  //display.println("HTTP server started");

  display.display();
}

void loop() {

  //try to parse packet
  int packetSize = LoRa.parsePacket();
  if (packetSize) {
    //received a packet
    Serial.print("Received packet ");

    //read packet
    while (LoRa.available()) {
      LoRaData = LoRa.readString();
      Serial.print(LoRaData);
    }

    //print Size of packet
    Serial.print(" with Size (bytes) ");
    Serial.print(packetSize);

    //print RSSI of packet
    int rssi = LoRa.packetRssi();

    Serial.print(" with RSSI ");
    Serial.println(rssi);



    // Dsiplay information
    display.clearDisplay();
    showScreen1(LoRaData, rssi, packetSize  );
    //delay(5000);
    //showScreen2(WiFi.localIP().toString().c_str());

  }

}
